## Kconfig
```kconfig
menu "W5100 configurations"
    menu "W5100 ethernet"
        config W5100_SPI_CS
            int "spi chip select pin (cs)"
            default 13
            range 0 31
            help
                Pin chip select for ethernet w5100 spi.

        config W5100_SPI_MOSI
            int "spi chip select pin (mosi)"
            default 12
            range 0 31
            help
                Pin master out for ethernet w5100 spi.

        config W5100_SPI_MISO
            int "spi chip select pin (miso)"
            default 14
            range 0 31
            help
                Pin master in for ethernet w5100 spi.

        config W5100_SPI_SCK
            int "spi chip select pin (sck)"
            default 27
            range 0 31
            help
                Pin clock for ethernet w5100 spi.

        config W5100_SPI_HOST
            int "spi host SPI1_HOST=0, SPI2_HOST=1, SPI3_HOST=2"
            default 2
            range 0 2
            help
                Num of spi host.
    endmenu

    menu "W5100 debug options"
        config W5100_DEBUG_TX
            bool "Dump data sent (TX)"
            help
                Dump data sent to the chip

        config W5100_DEBUG_RX
            bool "Dump data received (RX)"
            help
                Dump data received from the chip
    endmenu

    config EMAC_RECV_TASK_ENABLE_CORE_AFFINITY
        bool "Enable W5100 recv task core selection"
        default y
        help
            Enable this to manually set W5100's recv task affinity. May be needed
            in order to balance load across cores depending on workload.
            Leave it disabled for no affinity.

    config EMAC_RECV_TASK_CORE
        depends on EMAC_RECV_TASK_ENABLE_CORE_AFFINITY
        int "Which core?"
        range 0 1
        default 1
        help
            Select the core to pin the task to
            0 - PRO CPU
            1 - APP CPU

    config EMAC_RX_TASK_YIELD_TICKS
        int "RX task yield duration (ticks)"
        range 0 2147483647
        default 1
        help
            Amount of CPU ticks the RX task will yield after each run of its
            loop. Since the yield is performed by the ulTaskNotifyTake()
            function, this is also how long the task will wait for notifications
            from the EMAC. A value greater than 0 keeps the task from monopolizing
            CPU, which is especially useful in the presence of time-sensitive
            code or peripherals.
endmenu
```
